## drivers/soc/oplus/Kconfig
```kconfig
menu "Oplus SoC drivers"

config OPLUS_ARCH_FILE
    bool "for build directory oplus"
    default y
    ---help---
    say Y to buid in

source "drivers/soc/oplus/device_info/Kconfig"
source "drivers/soc/oplus/midas/Kconfig"
source "drivers/soc/oplus/system/Kconfig"

endmenu
```

## drivers/soc/oplus/system/Kconfig
```kconfig
# SPDX-License-Identifier: GPL-2.0-only
# Copyright (C) 2018-2020 Oplus. All rights reserved.
config OPLUS_SYSTEM_KERNEL
  bool "config oplus system feature "
  default y
  help
	define this config to add oplus sytstem kernel feature

config OPLUS_DEVICE_IFNO
  bool "config devinfo"
  tristate "config oplus devinfo"
  select OPLUS_ARCH_FILE
  help
	define this config to compile devinfo.c for device register.

source "drivers/soc/oplus/system/oplus_project/Kconfig"
source "drivers/soc/oplus/system/project_info/Kconfig"

#ifdef OPLUS_FEATURE_ACM
source "drivers/soc/oplus/system/acm/Kconfig"
#endif /* OPLUS_FEATURE_ACM */
#ifdef OPLUS_FEATURE_THEIA
source "drivers/soc/oplus/system/theia/Kconfig"
#endif /* OPLUS_FEATURE_THEIA */
```
